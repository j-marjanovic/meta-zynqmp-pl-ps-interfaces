## conf/layer.conf
```bitbake
# We have a conf and classes directory, add to BBPATH
BBPATH .= ":${LAYERDIR}"

# We have recipes-* directories, add to BBFILES
BBFILES += "${LAYERDIR}/recipes-*/*/*.bb \
            ${LAYERDIR}/recipes-*/*/*.bbappend"

BBFILE_COLLECTIONS += "meta-zynqmp-pl-ps-interfaces"
BBFILE_PATTERN_meta-zynqmp-pl-ps-interfaces = "^${LAYERDIR}/"
BBFILE_PRIORITY_meta-zynqmp-pl-ps-interfaces = "10"

LAYERDEPENDS_meta-zynqmp-pl-ps-interfaces = "core"
LAYERSERIES_COMPAT_meta-zynqmp-pl-ps-interfaces = "gatesgarth"
```
